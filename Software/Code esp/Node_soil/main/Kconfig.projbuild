## Software/Code esp/Node_soil/main/Kconfig.projbuild
```kconfig
menu "Application Configuration"

	choice DIRECTION
		prompt "Communication polarity"
		default SENDER
		help
			Select Communication polarity.
		config SENDER
			bool "As the sender"
			help
				As the sender.
		config RECEIVER
			bool "As the receiver"
			help
				As the receiver.
	endchoice

	choice FREQUENCY
		prompt "Frequency to use"
		default 433MHZ
		help
			Select Frequency to use.
		config 169MHZ
			bool "169MHz"
			help
				Frequency is 169MHz.
		config 433MHZ
			bool "433MHz"
			help
				Frequency is 433MHz.
		config 470MHZ
			bool "470MHz"
			help
				Frequency is 470MHz.
		config 866MHZ
			bool "866MHz"
			help
				Frequency is 866MHz.
		config 915MHZ
			bool "915MHz"
			help
				Frequency is 915MHz.
		config OTHER
			bool "Other"
			help
				Other Frequency.
	endchoice

	config OTHER_FREQUENCY
		depends on OTHER
		int "Frequency to use[MHz]"
		range 1 999
		default 433
		help
			Frequency to use[MHz].

	config ADVANCED
		bool "Enable Advanced settings"
		default false
		help
			Enable Advanced settings.

	config CODING_RATE
		depends on ADVANCED
		int "Error coding rate"
		range 1 4
		default 1
		help
			Error coding rate.

	config BANDWIDTH
		depends on ADVANCED
		int "Signal Bandwidth"
		range 0 9
		default 7
		help
			Signal Bandwidth.

	config SF_RATE
		depends on ADVANCED
		int "Spreading Factor"
		range 5 12
		default 7
		help
			Spreading Factor.

endmenu 
menu "I2C configuration"
	config EXAMPLE_DEV_COUNT
        int "Number of ADS111x"
        default 1
        help
            Number of ADS111x devices on the bus.

    config EXAMPLE_I2C_MASTER_SCL
        int "SCL GPIO Number"
        default 5 if IDF_TARGET_ESP8266
        default 6 if IDF_TARGET_ESP32C3
        default 19 if IDF_TARGET_ESP32 || IDF_TARGET_ESP32S2 || IDF_TARGET_ESP32S3
        help
            GPIO number for I2C Master clock line.

    config EXAMPLE_I2C_MASTER_SDA
        int "SDA GPIO Number"
        default 4 if IDF_TARGET_ESP8266
        default 5 if IDF_TARGET_ESP32C3
        default 18 if IDF_TARGET_ESP32 || IDF_TARGET_ESP32S2 || IDF_TARGET_ESP32S3
        help
            GPIO number for I2C Master data line.
endmenu
menu "1-Wire configuration"
    config EXAMPLE_ONEWIRE_GPIO
        int "GPIO Number of 1-Wire bus, or DQ"
        default 4 if IDF_TARGET_ESP8266
        default 18 if IDF_TARGET_ESP32C3
        default 17 if IDF_TARGET_ESP32 || IDF_TARGET_ESP32S2 || IDF_TARGET_ESP32S3
        help
            GPIO Number of 1-Wire bus, or DQ. You might need an external
            pullup resistor on the bus. See README.md for details.

    config EXAMPLE_DS18X20_ADDR
        hex "Address of the sensor"
        default "d000000016cf0628"
        help
            The address of the sensor. Change this to the address of your own
            sensor. You can find out the address of your sensor by running
            ds18x20_multi example. f44aedd4468cd228
endmenu
```
